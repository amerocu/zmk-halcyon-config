## boards/shields/mod_split_state_sync/dts/bindings/behaviors/zmk,behavior-poweroff.yaml
```yaml
# SPDX-License-Identifier: MIT
description: Shut down connected split peripherals after their final display update
compatible: "zmk,behavior-poweroff"
include: zero_param.yaml
```
